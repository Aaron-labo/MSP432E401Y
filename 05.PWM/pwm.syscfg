/**
 * @cliArgs --board "/ti/boards/MSP_EXP432E401Y" --product "simplelink_msp432e4_sdk@4.20.00.12"
 * @versions {"tool":"1.9.0+2015","templates":null}
 */

/**
 * Import the modules used in this configuration.
 */
const PWM   = scripting.addModule("/ti/drivers/PWM", {}, false);
const PWM1  = PWM.addInstance();
const RTOS  = scripting.addModule("/ti/drivers/RTOS");
const UART  = scripting.addModule("/ti/drivers/UART", {}, false);
const UART1 = UART.addInstance();

/**
 * Write custom configuration values to the imported modules.
 */
PWM1.$name              = "CONFIG_PWM_0";
PWM1.$hardware          = system.deviceData.board.components.D4;
PWM1.pwm.$assign        = "PWM0";
PWM1.pwm.pwmPin.$assign = "expansion.66";

RTOS.name = "NoRTOS";

UART1.$name     = "CONFIG_UART_0";
UART1.$hardware = system.deviceData.board.components.XDS110UART;

/**
 * Pinmux solution for unlocked pins/peripherals. This ensures that minor changes to the automatic solver in a future
 * version of the tool will not impact the pinmux you originally saw.  These lines can be completely deleted in order to
 * re-solve from scratch.
 */
UART1.uart.$suggestSolution       = "UART0";
UART1.uart.txPin.$suggestSolution = "expansion.76";
UART1.uart.rxPin.$suggestSolution = "expansion.74";
