/**
 * @cliArgs --board "/ti/boards/MSP_EXP432E401Y" --product "simplelink_msp432e4_sdk@4.20.00.12"
 * @versions {"tool":"1.9.0+2015","templates":null}
 */

/**
 * Import the modules used in this configuration.
 */
const RTOS   = scripting.addModule("/ti/drivers/RTOS");
const Timer  = scripting.addModule("/ti/drivers/Timer", {}, false);
const Timer1 = Timer.addInstance();
const UART   = scripting.addModule("/ti/drivers/UART", {}, false);
const UART1  = UART.addInstance();
const LED    = scripting.addModule("/ti/drivers/apps/LED", {}, false);
const LED1   = LED.addInstance();

/**
 * Write custom configuration values to the imported modules.
 */
RTOS.name = "NoRTOS";

Timer1.$name         = "CONFIG_TIMER_0";
Timer1.timerType     = "32 Bits";
Timer1.timer.$assign = "Timer0";

UART1.$name     = "CONFIG_UART_0";
UART1.$hardware = system.deviceData.board.components.XDS110UART;

LED1.$name     = "CONFIG_LED_0";
LED1.$hardware = system.deviceData.board.components.D1;

/**
 * Pinmux solution for unlocked pins/peripherals. This ensures that minor changes to the automatic solver in a future
 * version of the tool will not impact the pinmux you originally saw.  These lines can be completely deleted in order to
 * re-solve from scratch.
 */
UART1.uart.$suggestSolution           = "UART0";
UART1.uart.txPin.$suggestSolution     = "expansion.76";
UART1.uart.rxPin.$suggestSolution     = "expansion.74";
LED1.gpioPin.gpioPin.$suggestSolution = "expansion.87";
